## config/west.yml
```yaml
manifest:
  remotes:
    - name: zmkfirmware
      url-base: https://github.com/zmkfirmware
    - name: caksoylar
      url-base: https://github.com/caksoylar
    - name: badjeff
      url-base: https://github.com/badjeff
    - name: te9no
      url-base: https://github.com/te9no
    - name: kot149
      url-base: https://github.com/kot149
    - name: mctechnology17
      url-base: https://github.com/mctechnology17
    - name: urob
      url-base: https://github.com/urob
    - name: petejohanson
      url-base: https://github.com/petejohanson
  projects:
    - name: zmk
      # remote: zmkfirmware
      remote: te9no
      revision: main
      import: app/west.yml
    - name: zmk-rgbled-widget
      remote: caksoylar
      revision: v0.3-branch
    - name: zmk-pmw3610-driver
      remote: badjeff
      revision: zmk-0.3
    - name: zmk-analog-input-driver
      remote: badjeff
      revision: main
    - name: zmk-nice-oled
      remote: mctechnology17
      revision: main
    - name: zmk-layout-shift
      remote: kot149
      revision: v1
    - name: zmk-input-processor-keybind
      remote: te9no
      revision: main
    - name: cirque-input-module
      remote: petejohanson
      revision: main
    - name: zmk-driver-MLX90393
      remote: te9no
      revision: main
    - name: zmk-tri-state
      remote: urob
      revision: main
  self:
    path: config

    
```
