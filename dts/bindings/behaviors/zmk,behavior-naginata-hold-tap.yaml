## dts/bindings/behaviors/zmk,behavior-naginata-hold-tap.yaml
```yaml
description: Naginata-aware hold-tap behavior

compatible: "zmk,behavior-naginata-hold-tap"

include: two_param.yaml

properties:
  bindings:
    type: phandles
    required: true
  tapping-term-ms:
    type: int
    required: true
  tap-trigger-key-positions:
    type: array
    required: false
    description: Key positions that force the tap binding while held
```

## dts/bindings/behaviors/zmk,behavior-naginata-key.yaml
```yaml
description: Naginata key participating in Naginata-aware hold-tap chords

compatible: "zmk,behavior-naginata-key"

include: one_param.yaml

properties:
  binding:
    type: phandle
    required: true
  shortcut-binding:
    type: phandle
    required: true
    description: Raw key behavior used while an HRM modifier is active
  shortcut-key-position:
    type: int
    required: false
    description: Position whose English-layer keycode differs from the Naginata keycode
  shortcut-keycode:
    type: int
    required: false
    description: English-layer keycode override for shortcut-key-position
```

## dts/bindings/behaviors/zmk,behavior-naginata-space.yaml
```yaml
description: Time-independent Naginata space and layer behavior

compatible: "zmk,behavior-naginata-space"

include: two_param.yaml

properties:
  bindings:
    type: phandles
    required: true
  tapping-term-ms:
    type: int
    required: true
  tap-trigger-key-positions:
    type: array
    required: true
    description: Opposite-side positions that convert the held layer into Naginata Space
```
